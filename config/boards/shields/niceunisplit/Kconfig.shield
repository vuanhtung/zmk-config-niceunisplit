## config/boards/shields/niceunisplit/Kconfig.shield
```kconfig
# No whitespace after the comma or in your keyboard name!
config SHIELD_NICEUNISPLIT
    def_bool $(shields_list_contains,niceunisplit)
```
